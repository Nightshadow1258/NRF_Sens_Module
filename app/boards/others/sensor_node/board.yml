## app/boards/sensor_modul/Kconfig.defconfig
```kconfig
# Sensor Modul board configuration

# Copyright (c) 2024 Reisch Paul
# SPDX-License-Identifier: Apache-2.0

if BOARD_SENSOR_MODUL

# config BOARD_HAS_NRF5_BOOTLOADER
# 	bool "Board has nRF5 bootloader"
# 	default y
# 	help
# 	  If selected, applications are linked so that they can be loaded by Nordic
# 	  nRF5 bootloader.

config BOARD_ENABLE_DCDC
	bool "DCDC mode"
	select SOC_DCDC_NRF52X
	default n
	depends on BOARD_NRF52840DK_NRF52840



config BT_CTLR
	default BT

if USB_DEVICE_STACK

config UART_CONSOLE
	default CONSOLE

config USB_DEVICE_INITIALIZE_AT_BOOT
	default y

endif # USB_DEVICE_STACK

endif # BOARD_SENSOR_MODUL
```

## app/boards/sensor_modul/Kconfig.sensor_modul
```kconfig
# XIAO BLE board configuration

# Copyright (c) 2022 Marcin Niestroj
# SPDX-License-Identifier: Apache-2.0

config BOARD_SENSOR_MODUL
	select SOC_NRF52840_QIAA
```

## app/boards/sensor_module/sensor_module_defconfig
```kconfig
# SPDX-License-Identifier: Apache-2.0

# Enable MPU
CONFIG_ARM_MPU=y

# Enable hardware stack protection
CONFIG_HW_STACK_PROTECTION=y

# Enable RTT
CONFIG_USE_SEGGER_RTT=n

# Enable GPIO
CONFIG_GPIO=y

# Enable UART driver
CONFIG_SERIAL=y

# Enable console
CONFIG_CONSOLE=y
CONFIG_UART_CONSOLE=y
CONFIG_UART_LINE_CTRL=y  

# Build UF2 by default, supported by the Adafruit nRF52 Bootloader
# CONFIG_BUILD_OUTPUT_UF2=y
# CONFIG_USE_DT_CODE_PARTITION=y


CONFIG_BOARD_ENABLE_DCDC=n
CONFIG_CLOCK_CONTROL_NRF_K32SRC_RC=y
CONFIG_CLOCK_CONTROL_NRF_K32SRC_XTAL=n


CONFIG_LOG=y
CONFIG_LOG_PRINTK=y
CONFIG_LOG_BACKEND_UART=y

# CONFIG_USB_DEVICE_STACK=y
# CONFIG_USB_CDC_ACM=y
# CONFIG_USB_DEVICE_STACK=y
# CONFIG_USB_DEVICE_PRODUCT="Zephyr USB console sample"
# CONFIG_USB_DEVICE_PID=0x0004
```

## app/build/Kconfig/Kconfig.shield.defconfig
```kconfig
osource "/home/paul/zephyrproject/SensorNodeV3/app/boards/shields/*/Kconfig.defconfig"
```

## app/build/Kconfig/arch/Kconfig
```kconfig
# Load arch Kconfig descriptions.
osource "/home/paul/zephyrproject/zephyr/arch/x86/Kconfig"
osource "/home/paul/zephyrproject/zephyr/arch/xtensa/Kconfig"
osource "/home/paul/zephyrproject/zephyr/arch/sparc/Kconfig"
osource "/home/paul/zephyrproject/zephyr/arch/riscv/Kconfig"
osource "/home/paul/zephyrproject/zephyr/arch/posix/Kconfig"
osource "/home/paul/zephyrproject/zephyr/arch/nios2/Kconfig"
osource "/home/paul/zephyrproject/zephyr/arch/mips/Kconfig"
osource "/home/paul/zephyrproject/zephyr/arch/arm64/Kconfig"
osource "/home/paul/zephyrproject/zephyr/arch/arm/Kconfig"
osource "/home/paul/zephyrproject/zephyr/arch/arc/Kconfig"
```

## boards/vendor/sensor_node_uart/sensor_node_defconfig
```kconfig
# SPDX-License-Identifier: Apache-2.0

# Enable MPU
CONFIG_ARM_MPU=y

# Enable hardware stack protection
CONFIG_HW_STACK_PROTECTION=y

# Enable RTT
CONFIG_USE_SEGGER_RTT=n

# Enable GPIO
CONFIG_GPIO=y

# Enable UART driver
CONFIG_SERIAL=y

# Enable console
CONFIG_CONSOLE=y
CONFIG_UART_CONSOLE=y

# Build UF2 by default, supported by the Adafruit nRF52 Bootloader
# CONFIG_BUILD_OUTPUT_UF2=y
# CONFIG_USE_DT_CODE_PARTITION=y

CONFIG_LOG=y

# CONFIG_BOARD_ENABLE_DCDC=n
CONFIG_CLOCK_CONTROL_NRF_K32SRC_RC=y
CONFIG_CLOCK_CONTROL_NRF_K32SRC_XTAL=n


CONFIG_LOG=y
CONFIG_LOG_PRINTK=y
CONFIG_LOG_BACKEND_UART=y

CONFIG_USB_DEVICE_STACK=n
CONFIG_USB_DEVICE_PRODUCT="Zephyr USB console sample"
CONFIG_USB_DEVICE_PID=0x0004

CONFIG_SERIAL=y
CONFIG_CONSOLE=y
CONFIG_UART_CONSOLE=y
CONFIG_UART_LINE_CTRL=y
```
